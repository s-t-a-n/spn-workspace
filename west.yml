## west.yml
```yaml
manifest:
  remotes:
    - name: github
      url-base: https://github.com
    - name: github_ssh
      url-base: ssh://git@github.com
  projects:
    - name: zephyr
      remote: github
      repo-path: zephyrproject-rtos/zephyr
      revision: v4.4.0
      import:
        name-allowlist:
          - mbedtls
          - hal_nordic
          - hal_stm32
          - hal_espressif
          - cmsis_6
          - segger
    - name: etl
      remote: github
      repo-path: ETLCPP/etl
      revision: 20.49.0
      path: modules/lib/etl
    - name: spn
      remote: github
      repo-path: s-t-a-n/spn
      revision: develop
      west-commands: west-commands.yml
```
